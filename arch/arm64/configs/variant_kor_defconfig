## arch/arm64/configs/variant_kor_defconfig
```kconfig
CONFIG_DEFAULT_MPTCP_SCHED="default"
CONFIG_MPTCP=y
CONFIG_TCP_CONG_LIA=y
CONFIG_TCP_CONG_OLIA=y
CONFIG_TCP_CONG_WVEGAS=y
CONFIG_TDMB_FC8080=y
CONFIG_TDMB_SLSI=y
CONFIG_TDMB_SPI=y
CONFIG_TDMB_VENDOR_FCI=y
CONFIG_TDMB_XTAL_FREQ=y
CONFIG_TDMB=y
CONFIG_WLAN_REGION_CODE=200
```

## arch/arm64/configs/variant_xx_defconfig
```kconfig
CONFIG_SENSORS_SX9310_INIT_TOUCH_THRESHOLD=3000
CONFIG_SENSORS_SX9310_NORMAL_TOUCH_THRESHOLD=176
CONFIG_SENSORS_SX9310_NORMAL_TOUCH_THRESHOLD_CH2=246
CONFIG_SENSORS_SX9310=y
CONFIG_WLAN_REGION_CODE=100
```
